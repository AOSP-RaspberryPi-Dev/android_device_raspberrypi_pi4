/dts-v1/;
/plugin/;

/{
	compatible = "brcm,bcm2835";

	fragment@0 {
		target-path = "/soc";
		__overlay__ {
			nulldev-serial {
				compatible = "nulldev-serial";
				status = "okay";
			};
		};
	};

	fragment@1 {
		target-path = "/aliases";
		__overlay__ {
			serial0 = "/soc/nulldev-serial";
		};
	};
};
